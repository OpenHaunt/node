/*
 * Writes the pixel-effect corpus: `docs/14-pixel-effects.json`.
 *
 * A strip in `effect` mode is drawn by the node and, since the-pult can show it too,
 * by the console — two implementations of doc 14's effects in two languages. This
 * file is what holds them together: every effect under several parameter sets, at
 * several moments of the console clock, as the bytes this C draws. The node's own test
 * (`test_pixfx_corpus.c`) checks that the C still draws exactly these; the console's
 * `pult-render` reads the same file and must land within a byte of every one.
 *
 *   cmake --build build/host --target pixfx_corpus
 *   build/host/pixfx_corpus > ../docs/14-pixel-effects.json
 *
 * Regenerate only when an effect is changed on purpose, and say so in the commit: a
 * corpus rewritten to make a test pass is a corpus that guards nothing.
 */
#include <inttypes.h>
#include <stdio.h>

#include "oh_pixfx.h"

typedef struct {
    const char *name;
    oh_color_t color, color2;
    float brightness, speed, size;
    bool reverse, mirror;
    int segments;
} set_t;

static const set_t SETS[] = {
    {"plain", {255, 0, 0}, {0, 0, 255}, 1.0f, 1.0f, 0.25f, false, false, 1},
    {"dim, fast, mirrored in three", {255, 160, 20}, {0, 40, 0}, 0.6f, 2.5f, 0.4f, false, true, 3},
    {"slow, short, reversed in two", {30, 200, 255}, {90, 0, 60}, 1.0f, 0.7f, 0.1f, true, false, 2},
    {"flame colors, dense", {255, 40, 0}, {255, 200, 0}, 0.85f, 4.0f, 0.6f, false, false, 1},
    {"stopped", {255, 255, 255}, {10, 10, 10}, 1.0f, 0.0f, 0.5f, false, false, 1},
};

/* A console clock in 2025, and moments after it chosen to land inside a cycle, on a
 * cycle boundary, and well into the clock's range; and one a century on. */
static const int64_t T = 1760000000000LL;
static const int64_t AT[] = {T, T + 137, T + 1000, T + 2503, T + 61803, 4102444800000LL};
static const uint16_t COUNTS[] = {7, 30};

int main(void)
{
    printf("{\n");
    printf("  \"about\": [\n");
    printf("    \"OpenHaunt doc 14's pixel effects, as bytes: generated by the node firmware's\",\n");
    printf("    \"test/host/pixfx_corpus.c from oh_pixfx.c, and read by the node's\",\n");
    printf("    \"test_pixfx_corpus.c (exact) and by the-pult's pult-render (within a byte).\",\n");
    printf("    \"phase is oh_pixfx_phase_at(speed, now_ms); rgb is R G B per pixel, in hex.\"\n");
    printf("  ],\n");
    printf("  \"cases\": [\n");
    bool first = true;
    for (int k = 0; k < OH_PIXFX_COUNT; k++) {
        for (size_t s = 0; s < sizeof(SETS) / sizeof(SETS[0]); s++) {
            for (size_t a = 0; a < sizeof(AT) / sizeof(AT[0]); a++) {
                for (size_t c = 0; c < sizeof(COUNTS) / sizeof(COUNTS[0]); c++) {
                    const set_t *set = &SETS[s];
                    oh_pixfx_params_t p;
                    oh_pixfx_defaults(&p);
                    p.kind = (oh_pixfx_kind_t)k;
                    p.color = set->color;
                    p.color2 = set->color2;
                    p.brightness = set->brightness;
                    p.speed = set->speed;
                    p.size = set->size;
                    p.reverse = set->reverse;
                    p.mirror = set->mirror;
                    p.segments = set->segments;
                    const int64_t now = AT[a];
                    const uint16_t count = COUNTS[c];
                    const float phase = oh_pixfx_phase_at(p.speed, now);
                    uint8_t rgb[3 * 30];
                    oh_pixfx_render(&p, phase, now, count, rgb);

                    printf("%s    {\"name\": \"%s, %s, at +%" PRId64 " ms, %u pixels\",\n", first ? "" : ",\n",
                           oh_pixfx_str(p.kind), set->name, now - T, count);
                    printf("     \"effect\": \"%s\", \"color\": [%u, %u, %u], \"color2\": [%u, %u, %u],\n",
                           oh_pixfx_str(p.kind), p.color.r, p.color.g, p.color.b, p.color2.r, p.color2.g,
                           p.color2.b);
                    printf("     \"brightness\": %.9g, \"speed\": %.9g, \"size\": %.9g, \"reverse\": %s, "
                           "\"mirror\": %s, \"segments\": %d,\n",
                           p.brightness, p.speed, p.size, p.reverse ? "true" : "false",
                           p.mirror ? "true" : "false", p.segments);
                    printf("     \"now_ms\": %" PRId64 ", \"count\": %u, \"phase\": %.9g,\n", now, count, phase);
                    printf("     \"rgb\": \"");
                    for (int i = 0; i < 3 * count; i++) {
                        printf("%02x", rgb[i]);
                    }
                    printf("\"}");
                    first = false;
                }
            }
        }
    }
    printf("\n  ]\n}\n");
    return 0;
}
